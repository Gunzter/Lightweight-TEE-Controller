## CMakeLists.txt
```
cmake_minimum_required(VERSION 3.20.0)
#set(BOARD qemu_x86) change to nRF3540.....

find_package(Zephyr)
project(uart_test)

target_sources(app PRIVATE 
  src/main.c
  src/serial2002.c
)
```

## sample.yaml
```
sample:
  description: Non-secure ball and beam controller.
  name: Non Secure Controller
common:
    tags: introduction
    integration_platforms:
      - native_posix
    harness: console
    harness_config:
      type: one_line
      regex:
        - "Hello World! (.*)"
```

## prj.conf
```kconfig
# Enable the UART driver
CONFIG_SERIAL=y
CONFIG_CONSOLE=y
CONFIG_UART_CONSOLE=y
CONFIG_CBPRINTF_FP_SUPPORT=y
```

## boards/nrf5340dk_nrf5340_cpuapp.overlay
```dts
/* 33 = P1.01
 * 34 = P1.02
 * Connect:
 * P1.01 <--> TxD
 * P1.02 <--> RxD
 */
&uart1 {
    status = "okay";
    current-speed = <115200>;
    rx-pin = <33>; 
    tx-pin = <34>;
};
```

## src/main.c
```c
#include <zephyr.h>
#include <device.h>
#include <devicetree.h>
#include <sys/printk.h>
#include <drivers/uart.h>
#include <drivers/gpio.h>
#include <string.h>
#include <stdio.h>

#include "serial2002.h"

/* uart1 is defined in an .overlay, so DT_CHOSEN() does not work for some
 * reason. 
 */
#define UART1_DEVICE_NODE DT_NODELABEL(uart1)
const struct device *serial2002_uart_dev = DEVICE_DT_GET(UART1_DEVICE_NODE);

#define GPIO0_DEVICE_NODE DT_NODELABEL(gpio0)
const struct device *gpio_dev = DEVICE_DT_GET(GPIO0_DEVICE_NODE);
#define MALICIOUS_PIN 27
#define MAL_WAIT_PIN  28
#define CTRL_PIN      29


/* Static function for controller file */
static float get_ref(void);

static float convert_in(uint32_t);

static float calc_ctrl(float*, float);
static void update_ctrl(float*, float);
static float ctrl_signal = 0.0f;

static int ctr = 0;
static int running = 1;

/* Shared with serial2002.c */
uint32_t raw_meas[2];

static float meas[2];
static float z1 = 0.0f, z2 = 0.0f, z3 = 0.0f;
extern int32_t uart_status;
extern uint32_t received_bytes;

/* Shared variables and data can be here */
#define SAMPLE_TIME_MILLI       ( (uint32_t) 10 )
#define SAMPLE_TIME_MICRO       ( (uint32_t) 10000 )
#define SAMPLE_TIME_SECONDS     ( ( (float) SAMPLE_TIME_MICRO ) / 1000000.0f )
#define REFERENCE_PERIOD_MILLIS ( (int64_t) 20000 )
#define REFERENCE_AMPLITUDE     ( 6.0f )
#define DEADTIME_MILLIS         ( (int64_t) 10000 )

/* Defines for Zephyr OS threads */
#define STACKSIZE 1024
#define PRIORITY    1
#define MALICIOUS_PRIORITY    -5

static uint64_t log_ctr = 0;
void print_log(){
  if(log_ctr++ % 10 == 0){
    printf("ang: %f pos: %f u %f\n", meas[0], meas[1], ctrl_signal);
  }
}


/* This define activate the resource starvation attack. */
#define ATTACK 1

#define TAU_M 1.5f
#define MAL_DEADTIME_MILLIS 3*DEADTIME_MILLIS
uint32_t mal_ctr = 0;

struct k_thread malicious_task;
static K_KERNEL_STACK_DEFINE(malicious_thread_stack, STACKSIZE);
void malicious_wait_thread(void){
      k_busy_wait(TAU_M * SAMPLE_TIME_MICRO);
      return;
}


void control_loop(void)
{
  /* Get current time in ms */
  int64_t t_per = k_uptime_get(), dur;

  while(true) {
    gpio_pin_set(gpio_dev, CTRL_PIN, true);
    
    /* Get measurement values and perform proper conversion */
    get_ang();                              // Ang
    receive_value(); //blocking
    meas[0] = convert_in(raw_meas[0]);
    get_pos();                              // Pos
    receive_value(); //blocking 
    meas[1] = convert_in(raw_meas[1]);

    /* Malicious wait here */
    if( ATTACK && (k_uptime_get() > MAL_DEADTIME_MILLIS) ){
      /*Pin high when attack is on, led on on GPIO 0*/
      gpio_pin_set(gpio_dev, MALICIOUS_PIN, false);

      gpio_pin_set(gpio_dev, MAL_WAIT_PIN, true);
      k_thread_create(&malicious_task, malicious_thread_stack, STACKSIZE, (k_thread_entry_t)malicious_wait_thread, NULL, NULL, NULL, MALICIOUS_PRIORITY, 0, K_NO_WAIT);
      gpio_pin_set(gpio_dev, MAL_WAIT_PIN, false);
    }
    
    /* Fail-Safe */
    if (meas[0] > 6 || meas[0] < -6)
    {
      set_ctrl(0.0f);
      running = 0;
    } else if ( running && (k_uptime_get() > DEADTIME_MILLIS) )
    {
      /* Get reference signal */
      //    float ref = 0.0f;
      float ref = get_ref();

      /* Calculate next control signal */
      ctrl_signal = -1.0f * calc_ctrl(meas, ref);

      /* set actuation signals (first velocity and then acceleration) */
      set_ctrl(ctrl_signal);

      /* Update control state */
      update_ctrl(meas, ref);
    } else
    {
      set_ctrl(0.0f);
    }

    /* Print loggin values every 50th iteration */
    //print_log();
    
    /* Get duration to sleep, in ms. */
    t_per += SAMPLE_TIME_MILLI;
    dur = t_per - k_uptime_get();

    gpio_pin_set(gpio_dev, CTRL_PIN, false);
    /* Wait */
    if (dur > 0) {
      k_msleep(dur);
    }
  }
}

K_THREAD_DEFINE(control_thread_id, STACKSIZE, control_loop, NULL, NULL, NULL, PRIORITY, 0, 0);

void main(void)
{

  if (!device_is_ready(serial2002_uart_dev)) {
    printk("Secondary UART device not found!");
    return;
  }

  /* configure interrupt and callback to receive data */
  uart_irq_rx_enable(serial2002_uart_dev);

  /* Configure GPIO pins to output */
  int ret;
  ret = gpio_pin_configure(gpio_dev, MALICIOUS_PIN, GPIO_OUTPUT_ACTIVE);
  if (ret < 0) {
    return;
  }
  /* turn of led */
  gpio_pin_set(gpio_dev, MALICIOUS_PIN, true);
  ret = gpio_pin_configure(gpio_dev, MAL_WAIT_PIN, GPIO_OUTPUT_ACTIVE);
  if (ret < 0) {
    return;
  }
  ret = gpio_pin_configure(gpio_dev, CTRL_PIN, GPIO_OUTPUT_ACTIVE);
  if (ret < 0) {
    return;
  }


  printk("Starting Controller\r\n");

}

/* Get position reference (triangle wave) */
static float get_ref(void)
{
  int64_t t = k_uptime_get();
  int64_t ref_tmp = t % REFERENCE_PERIOD_MILLIS;
  if ( ref_tmp < (int64_t) (REFERENCE_PERIOD_MILLIS / 4) )
    return 4*REFERENCE_AMPLITUDE * ref_tmp / REFERENCE_PERIOD_MILLIS;
  else if ( ref_tmp > (int64_t) (3 * REFERENCE_PERIOD_MILLIS / 4) )
    return 4*REFERENCE_AMPLITUDE * ref_tmp / REFERENCE_PERIOD_MILLIS - 4*REFERENCE_AMPLITUDE;
  else
    return -4*REFERENCE_AMPLITUDE * ref_tmp / REFERENCE_PERIOD_MILLIS + 2*REFERENCE_AMPLITUDE;
}

#define IN_CONVERTION_K   ( 0.00007629424f )
#define IN_CONVERTION_M   ( -10.0f )

/* Converts raw position p_raw to a position in meters */
static float convert_in(uint32_t pos_raw)
{
  return (float) ( IN_CONVERTION_K * pos_raw + IN_CONVERTION_M );
}

/*********************************************************** 
 * TODO: NOTE THAT WE ARE CURRENTLY IGNORING REFERENCE VALUE 
 ***********************************************************/

#include "lqg_variables.h"

/* Calculate control signal */
static float calc_ctrl(float *meas, float ref)
{
  return H_1 * z1 + H_2 * z2 + H_3 * z3 + K_1 * meas[0] + K_2 * (meas[1] - ref);
}

/* Update control state */
static void update_ctrl(float *meas, float ref)
{
  float z1new, z2new, z3new;
  z1new = F_11 * z1 + F_12 * z2 + F_13 * z3 + G_11 * meas[0] + G_12 * (meas[1] - ref);
  z2new = F_21 * z1 + F_22 * z2 + F_23 * z3 + G_21 * meas[0] + G_22 * (meas[1] - ref);
  z3new = F_31 * z1 + F_32 * z2 + F_33 * z3 + G_31 * meas[0] + G_32 * (meas[1] - ref);
  z1 = z1new;
  z2 = z2new;
  z3 = z3new;
}
```

## src/lqg_variables.h
```c
#define F_11 	( 0.708674069f )
#define F_12 	( 0.054032842f )
#define F_13 	( 0.041070829f )
#define F_21 	( 0.010551467f )
#define F_22 	( 0.997298358f )
#define F_23 	( -0.218582049f )
#define F_31 	( 0.003634293f )
#define F_32 	( 0.009990995f )
#define F_33 	( 0.933598148f )
#define G_11 	( 0.151618323f )
#define G_12 	( 0.000768178f )
#define G_21 	( -0.103566087f )
#define G_22 	( 0.216490098f )
#define G_31 	( -0.004111009f )
#define G_32 	( 0.066394879f )
#define H_1 	( 2.432765995f )
#define H_2 	( -1.200729817f )
#define H_3 	( -0.561996667f )
#define K_1 	( 0.671847531f )
#define K_2 	( -0.367759035f )
```

## src/serial2002.c
```c
/* Serial2002 - a lightweight Serial2002 implementation.
 * Copyright (C) Anders Blomdell Department of Automatic Control
 *
 * This program is free software: you can redistribute it and/or modify
 * it under the terms of the GNU General Public License as published by
 * the Free Software Foundation, either version 3 of the License, or
 * (at your option) any later version.
 * 
 * This program is distributed in the hope that it will be useful,
 * but WITHOUT ANY WARRANTY; without even the implied warranty of
 * MERCHANTABILITY or FITNESS FOR A PARTICULAR PURPOSE.  See the
 * GNU General Public License for more details.
 * 
 * You should have received a copy of the GNU General Public License
 * along with this program.  If not, see <http://www.gnu.org/licenses/>.
 */

/*
 * Modified for the nRF5340 platform by Martin Gunnarsson and Nils Vreman.
 */

#include "serial2002.h"
#include <stdio.h>
#include <string.h>
#include "drivers/uart.h"

// UART driver
extern const struct device *serial2002_uart_dev;

//write directly to meas_raw
extern uint32_t raw_meas[2];

/* Internal SerialIO variables */
static volatile unsigned long serialio_value = 0;
static volatile unsigned char serialio_channel = 255;
static volatile unsigned char serialio_length = 0;

static unsigned long read_value = 0;
static unsigned char read_channel = 255;

int32_t uart_status = 0;
uint32_t received_bytes = 0;

/* Send byte over UART to the plant */
static inline void uart_send(unsigned char byte, unsigned long len)
{
    uart_poll_out(serial2002_uart_dev, byte);
}


/* Send one bit to specific channel */
void serialio_putbit( unsigned char channel, unsigned char value)
{
    if (value) {
        uart_send( 0x20 | (channel & 0x1f), 1);
    } else {
        uart_send( 0x00 | (channel & 0x1f), 1);
    }
}

/* Poll specific channel. TODO: Is this correct? */
void serialio_getchannel( unsigned char channel)
{
    uint8_t byte = 0x60 | (channel & 0x1f);
    uart_send( byte, 1 );
}

/* Send value (less than 4 bytes) to channel */
void serialio_putchannel( unsigned char channel, unsigned long value )
{
    if (value >= (1L<<30)) { uart_send( 0x80 | ((value >> 30) & 0x03), 1); }
    if (value >= (1L<<23)) { uart_send( 0x80 | ((value >> 23) & 0x7f), 1); }
    if (value >= (1L<<16)) { uart_send( 0x80 | ((value >> 16) & 0x7f), 1); }
    if (value >= (1L<< 9)) { uart_send( 0x80 | ((value >> 9) & 0x7f), 1); }
    uart_send(0x80 | ((value >> 2) & 0x7f), 1);
    uart_send( ((value << 5) & 0x60) | (channel & 0x1f), 1);
}

/* Reads channel and value from character ch */
serialio_rxc_status serialio_RXC(unsigned char ch, unsigned long *value, unsigned char *channel)
{
    unsigned char result = serialio_error;

    if (serialio_length == 0) {
        serialio_value = 0;
    }
    serialio_length++;

    /* check whether channel has first bit set */
    if ((ch & 0x80) == 0x80) {
        // Collect yet another byte for later processing
        serialio_value = (serialio_value << 7) | (ch & 0x7f);
        result = serialio_more;
    } else {
        serialio_value = (serialio_value << 2) | ((ch & 0x60) >> 5);
        serialio_channel = ch & 0x1f;
        if (serialio_length == 1) {
            switch (serialio_value & 0x03) {
                // Digital output buffer (ULN2803A) is inverting
                case 0: { result = serialio_clearbit; } break;
                case 1: { result = serialio_setbit; } break;
                case 2: { result = serialio_pollbit; } break;
                case 3: { result = serialio_pollchannel; } break;
            }
        } else {
            result = serialio_setchannel;
        }
        serialio_length = 0;
    }
    *value = serialio_value;
    *channel = serialio_channel;
    return result;
}

void receive_value()
{
    /* Initialise variables */
    serialio_rxc_status status;
    uint8_t c;
    uint8_t more = 1;

    /* While we have more data to read */
    while ( more ) {

        /* Read one byte from UART. uart_poll_in() return 0 on success, otherwise negative number */
         
        uart_status = uart_poll_in(serial2002_uart_dev, &c);
        /* If we read something */
        if ( uart_status == 0 ) {

            /* Increment the number of received bytes */
            received_bytes += uart_status;

            /* Read 32 Bit value and channel from character c */
            status = serialio_RXC(c, &read_value, &read_channel);

            /* Depending on status, store the read value in raw_meas array */
            if ( status == serialio_setchannel ) {

                switch ( read_channel ) { 
                    case BEAM_ANG_CHANNEL:
                        raw_meas[0] = read_value;
                        break;
                    case BALL_POS_CHANNEL:
                        raw_meas[1] = read_value;
                        break;
                    default:
                        break;
                }
                more = 0;
                return;

            } else if ( status == serialio_pollchannel ) { /* NOTE: Shouldn't occur */ 
                more = 0;
            } else {                                       /* or continue reading from serialio */
                more = 1;   
            }

        } else if (uart_status == -1) {
        //    printf("Reading from empty buffer\n");
        } else {
       //    printf("Read fail %02x  \n", c);
            uart_status = status;
            return;
        }
    }
}


int32_t get_pos(void)
{
    serialio_getchannel(BALL_POS_CHANNEL);
    return 0;
}

int32_t get_ang(void)
{
    serialio_getchannel(BEAM_ANG_CHANNEL);
    return 0;
}

void set_ctrl(float u)
{
    /* convert control signal (in range -10 to 10) to uint32_t with 16 bit
     * resolution */
    uint32_t u_raw;
    if (u > 10.0f)
        u_raw = 0xFFFF; // 0xFFFF = 10 V = FULL TORQUE ONE DIRECTION (hex, control representation, ...)
    else if (u < -10.0f)
        u_raw = 0x0000; // 0x0000 = -10 V = FULL TORQUE OTHER DIRECTION (hex, control representation, ...)
    else
        u_raw = (uint32_t) ((u + 10.0f) / 20.0f * (float) 0xFFFF);

    // Actuate (channel 0) with u_raw (in a 16 bit representation)
    serialio_putchannel(0x00, u_raw);  // Velocity represented by 16 bits in AVR code
}
```

## src/serial2002.h
```c
/* Serial2002 - a lightweight Serial2002 implementation.
 * Copyright (C) Anders Blomdell Department of Automatic Control
 *
 * This program is free software: you can redistribute it and/or modify
 * it under the terms of the GNU General Public License as published by
 * the Free Software Foundation, either version 3 of the License, or
 * (at your option) any later version.
 * 
 * This program is distributed in the hope that it will be useful,
 * but WITHOUT ANY WARRANTY; without even the implied warranty of
 * MERCHANTABILITY or FITNESS FOR A PARTICULAR PURPOSE.  See the
 * GNU General Public License for more details.
 * 
 * You should have received a copy of the GNU General Public License
 * along with this program.  If not, see <http://www.gnu.org/licenses/>.
 */

/*
 * Digital in/out and poll commands are sent as one byte:
 *
 *   +-+-+-+-+-+-+-+-+
 *   |0|0 0|  chan   | Bit clear
 *   +-+-+-+-+-+-+-+-+
 *
 *   +-+-+-+-+-+-+-+-+
 *   |0|0 1|  chan   | Bit set
 *   +-+-+-+-+-+-+-+-+
 *
 *   +-+-+-+-+-+-+-+-+
 *   |0|1 0|  chan   | Bit get
 *   +-+-+-+-+-+-+-+-+
 *
 *   +-+-+-+-+-+-+-+-+
 *   |0|1 1|  chan   | Channel get
 *   +-+-+-+-+-+-+-+-+
 *
 *
 * Channels are sent as 2 to 6 bytes, depending on resolution:
 *
 *   +-+-+-+-+-+-+-+-+  +-+-+-+-+-+-+-+-+ 
 * 2 |1| bit8...bit2 |  |0|bit|  chan   |
 *   +-+-+-+-+-+-+-+-+  +-+-+-+-+-+-+-+-+ 
 *
 *   +-+-+-+-+-+-+-+-+  +-+-+-+-+-+-+-+-+  +-+-+-+-+-+-+-+-+ 
 * 3 |1|bit15...bit9 |  |1| bit8...bit2 |  |0|bit|  chan   |
 *   +-+-+-+-+-+-+-+-+  +-+-+-+-+-+-+-+-+  +-+-+-+-+-+-+-+-+ 
 *
 *   ...
 *
 *   +-+-+-+-+-+-+-+-+  +-+-+-+-+-+-+-+-+     +-+-+-+-+-+-+-+-+ 
 * 6 |1|bit31...bit30|  |1|bit29...bit23| ... |0|bit|  chan   |
 *   +-+-+-+-+-+-+-+-+  +-+-+-+-+-+-+-+-+     +-+-+-+-+-+-+-+-+ 
 *
 *
 *
 * Channel 31 is special, as it serves as the configuration channel. When
 * reading from it multiple responses are sent with the following layout
 *
 * +-+-+-+-+-+-+-+-|-+-+-+-+-+-+-+-|-+-+-+-+-+-+-+-|-+-+-+-+-+-+-+-+
 * |           command specific data           |cmd|kind |conf chan|
 * +-+-+-+-+-+-+-+-|-+-+-+-+-+-+-+-|-+-+-+-+-+-+-+-|-+-+-+-+-+-+-+-+
 *
 *  kind: 000 == end of configuration
 *        001 == digital in
 *        010 == digital out
 *        011 == analog in
 *        100 == analog out
 *        101 == counter in
 *
 *cmd == 0 (Resolution)
 *
 * +-+-+-+-+-+-+-+-|-+-+-+-+-+-+-+-|-+-+-+-+-+-+-+-|-+-+-+-+-+-+-+-+
 * |                               | # of bits |0 0|kind |conf chan|
 * +-+-+-+-+-+-+-+-|-+-+-+-+-+-+-+-|-+-+-+-+-+-+-+-|-+-+-+-+-+-+-+-+
 *
 *  # of bits (1..32) 
 *
 *cmd == 1 (Minimum value)
 *
 * +-+-+-+-+-+-+-+-|-+-+-+-+-+-+-+-|-+-+-+-+-+-+-+-|-+-+-+-+-+-+-+-+
 * |              minimum              |S| unit|0 1|kind |conf chan|
 * +-+-+-+-+-+-+-+-|-+-+-+-+-+-+-+-|-+-+-+-+-+-+-+-|-+-+-+-+-+-+-+-+
 * 
 *  S (sign): 0 == +
 *            1 == -
 *  unit: 000 == V
 *        001 == mV
 *        010 == uV
 *        100 == A
 *
 *cmd == 2 (Maximum value)
 *
 * +-+-+-+-+-+-+-+-|-+-+-+-+-+-+-+-|-+-+-+-+-+-+-+-|-+-+-+-+-+-+-+-+
 * |              maximum              |S| unit|1 0|kind |conf chan|
 * +-+-+-+-+-+-+-+-|-+-+-+-+-+-+-+-|-+-+-+-+-+-+-+-|-+-+-+-+-+-+-+-+
 * 
 *  S (sign): 0 == +
 *            1 == -
 *  unit: 000 == V
 *        001 == mV
 *        010 == uV
 *        100 == A
 */

#include <stdint.h>

typedef enum { 
  serialio_error, serialio_more, serialio_clearbit, serialio_setbit, 
  serialio_setchannel, serialio_pollbit, serialio_pollchannel 
} serialio_rxc_status;

void serialio_putbit( unsigned char channel, unsigned char value);

void serialio_getchannel( unsigned char channel);


void serialio_putchannel( unsigned char channel, 
				       unsigned long value);

serialio_rxc_status serialio_RXC(unsigned char ch, unsigned long *value, unsigned char *channel);

//TODO return error value here
void receive_value();

int32_t get_pos(); 
int32_t get_ang(); 
void set_ctrl(float);

#define BEAM_ANG_CHANNEL         0x00
#define BALL_POS_CHANNEL         0x01

#define CONF_DIG_IN(channel) (0x20 | (channel)&0x1f)
#define CONF_DIG_OUT(channel) (0x40 | (channel)&0x1f)

#define CONF_END() serialio_putchannel(31, 0)
#define CONF_DIGITAL_IN(chan, config) \
  serialio_putchannel(31, (0x20|(chan&0x1f)|(config&0xffffff00)))
#define CONF_DIGITAL_OUT(chan, config) \
  serialio_putchannel(31, (0x40|(chan&0x1f)|(config&0xffffff00)))
#define CONF_ANALOG_IN(chan, config) \
  serialio_putchannel(31, (0x60|(chan&0x1f)|(config&0xffffff00)))
#define CONF_ANALOG_OUT(chan, config) \
  serialio_putchannel(31, (0x80|(chan&0x1f)|(config&0xffffff00)))
#define CONF_ENCODER_IN(chan, config) \
  serialio_putchannel(31, (0xa0|(chan&0x1f)|(config&0xffffff00)))
#define CONF_RESOLUTION(bits) (((bits)<<10)|0x000)
#define CONF_MIN(value) ((value)|0x100)
#define CONF_MAX(value) ((value)|0x200)
#define CONF_NEGATIVE_VOLT(volt) (((long)(volt)<<14)|0x2000)
#define CONF_POSITIVE_VOLT(volt) ((long)(volt)<<14)
#define CONF_NEGATIVE_MILLIVOLT(millivolt) (((long)(millivolt)<<14)|0x2400)
#define CONF_POSITIVE_MILLIVOLT(millivolt) ((long)(millivolt)<<14|0x400)
#define CONF_POSITIVE_AMPERE(ampere) (((long)(ampere)<<14)|0x1000)
```
