## CMakeLists.txt
```
#
# Copyright (c) 2021 Nordic Semiconductor ASA
#
# SPDX-License-Identifier: Apache-2.0
#

cmake_minimum_required(VERSION 3.20)

find_package(Zephyr REQUIRED HINTS $ENV{ZEPHYR_BASE})

get_target_property(TFM_BINARY_DIR tfm TFM_BINARY_DIR)
configure_file(
  ${CMAKE_CURRENT_LIST_DIR}/secure_controller/tfm_manifest_list.yaml.in
  ${CMAKE_CURRENT_BINARY_DIR}/secure_controller/tfm_manifest_list.yaml
)

set_property(TARGET zephyr_property_target
  APPEND PROPERTY TFM_CMAKE_OPTIONS
  -DTFM_EXTRA_MANIFEST_LIST_FILES=${CMAKE_CURRENT_BINARY_DIR}/secure_controller/tfm_manifest_list.yaml
  -DTFM_EXTRA_PARTITION_PATHS=${CMAKE_CURRENT_LIST_DIR}/secure_controller
)

project(tfm_secure_controller)

target_sources(app PRIVATE
  src/main.c
)

target_include_directories(app PRIVATE
  ${ZEPHYR_TRUSTED_FIRMWARE_M_MODULE_DIR}/interface/include
)

target_compile_definitions(app
  PRIVATE TFM_PARTITION_SECURE_CONTROLLER
)
```

## sample.yaml
```
common:
    tags: tfm
    platform_allow: mps2_an521_ns v2m_musca_s1_ns
                    nrf5340dk_nrf5340_cpuapp_ns nrf9160dk_nrf9160_ns
sample:
  name: "TFM Secure Partition Sample"

tests:
  sample.tfm.secure_partition:
    tags: tfm
  sample.tfm.secure_partition.ipc:
    tags: tfm
    extra_args: "CONFIG_TFM_IPC=y"
```

## prj.conf
```kconfig
#
# Copyright (c) 2021 Nordic Semiconductor ASA
#
# SPDX-License-Identifier: Apache-2.0
#

CONFIG_BUILD_WITH_TFM=y
CONFIG_TFM_IPC=y

CONFIG_TFM_SPM_LOG_LEVEL_SILENCE=y
```

## src/main.c
```c
#include <zephyr.h>
#include <tfm_veneers.h>
#include <tfm_ns_interface.h>
#include "psa/client.h"
#include "psa_manifest/sid.h"

/* This define activate the resource starvation attack. */
#define ATTACK 1


psa_status_t secure_function(void *p_string, size_t string_len)
{
    psa_status_t status;
    psa_outvec out_vec[] = {
        { .base = p_string, .len = string_len }
    };

    status = psa_call(TFM_SC_SET_PROCESS_HANDLE, PSA_IPC_CALL, NULL, 0, out_vec, IOVEC_LEN(out_vec));
    return status; 
}


void main(void)
{
    printk("Starting NSPE Thread\n");
    char str[80];
    size_t str_len = 80;
    while(true) {
        k_msleep(2*1000);

        psa_status_t status = secure_function(str, str_len);
        if (status != PSA_SUCCESS) {
            printk("status: %d\n", status);
        } else {
            printk("%s \n", str);
        }
    } 
}

#if ATTACK == 1
#define STACKSIZE 1024
#define PRIORITY    1

volatile uint64_t d = 0;

void dummy(void){
  while(true){
    d++;
  }
}

K_THREAD_DEFINE(dummy_thread_id, STACKSIZE, dummy, NULL, NULL, NULL, PRIORITY, 0, 0);
#endif /* ATTACK == 1 */
```
